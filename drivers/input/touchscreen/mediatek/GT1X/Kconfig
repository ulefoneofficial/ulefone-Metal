## drivers/input/touchscreen/mediatek/GT1X/Kconfig
```kconfig
#
# Touchscreen driver configuration
#
if TOUCHSCREEN_MTK_GT1X

config GT1X_CONFIG
	string "GT1X for Mediatek config"

endif
```

## drivers/input/touchscreen/mediatek/GT9XXX/Kconfig
```kconfig
#
# Touchscreen driver configuration
#
if TOUCHSCREEN_MTK_GT9XXX

config GT9XXX_CONFIG
	string "GT9XXX for Mediatek config"

endif
```

## drivers/input/touchscreen/mediatek/gslX68X/Kconfig
```kconfig
#
# Touchscreen driver configuration
#
if TOUCHSCREEN_MTK_GSLX68X

config GSLX68X_CONFIG
	string "GSLX68X for Mediatek config"

endif
```

## drivers/input/touchscreen/mediatek/hx852xes/Kconfig
```kconfig
#
# Himax Touchscreen driver configuration
#
if TOUCHSCREEN_MTK_HX8527_ZAW875

config TOUCHSCREEN_HIMAX_I2C
        tristate "HIMAX HX852xES serious i2c touchscreen"
		depends on TOUCHSCREEN_MTK_HX8527_ZAW875
		help
		This enables support for HIMAX HX852xES over I2C based touchscreens.

config TOUCHSCREEN_HIMAX_DEBUG
        tristate "HIMAX debug function"
		depends on TOUCHSCREEN_HIMAX_I2C
		help
		This enables support for HIMAX debug function.
config HMX_DB
	tristate "HIMAX driver test over Dragon Board"
	depends on TOUCHSCREEN_HIMAX_I2C
	help
	  This enables support for HIMAX driver test over Dragon Board.

endif 
```

## drivers/misc/mediatek/accelerometer/mxc622x-new/Kconfig
```kconfig
config MTK_MXC622X_NEW
	bool "MXC622X for MediaTek package"
	default n
	help
	  It support different accelerometer sensor.
          If this option is set,
	  it will support
          MXC622X Accelerometer.
```

## drivers/misc/mediatek/camkey/Kconfig
```kconfig
config LY_GPIO_CAMKEY_SUPPORT
	tristate "GPIO camkey support"
	depends on GPIOLIB
	help
	  Say Y here to enable GPIO based camkey support.
```

## drivers/misc/mediatek/fingerprint_ly/Kconfig
```kconfig
#
#Fingerprint
#

config LY_FINGERPRINT
	tristate "Lingyang Fingerprint"
	default n
	---help---
	Fingerprint Lingyang driver enable/disable in the kernel.
	Say Y here if you want to use lingyang fingerprint driver,
	fingerprint driver will support fingerprint function in REE,
	it supports et310 or afs120 or gtx1xm device.

config LY_FINGERPRINT_ET310_SUPPORT
	tristate "ET310 fingerprint Driver"
  	default n
  	help
    	ET310 fingerprint Driver
    	This config is used to enable the corresponding
    	fingerprint driver for the fingerprint module
    	Set as y if the driver is used in this project

config LY_FINGERPRINT_AFS120_SUPPORT
 	tristate "AFS120 fingerprint Driver"
  	default n
  	help
    	AFS120 fingerprint Driver
    	This config is used to enable the corresponding
    	fingerprint driver for the fingerprint module
    	Set as y if the driver is used in this project

config LY_FINGERPRINT_GFX1XM_SUPPORT
  	tristate "GFX1XM fingerprint Driver"
  	default n
  	help
    	GFX1XM fingerprint Driver
    	This config is used to enable the corresponding
    	fingerprint driver for the fingerprint module
    	Set as y if the driver is used in this project
```

## drivers/misc/mediatek/magnetometer/mxg2320-new/Kconfig
```kconfig
config MTK_MXG2320_NEW
	bool "MXG2320 for MediaTek package"
	default n
	help
	  It support different magnetometer sensor.
          If this option is set,
	  it will support
          MXG2320 magnetometer.
```

## drivers/misc/mediatek/switch/Kconfig
```kconfig
config LY_GPIO_SWITCH_SUPPORT
	tristate "GPIO Swith support"
	depends on GPIOLIB
	help
	  Say Y here to enable GPIO based switch support.
```
